## allwinner/eyesee-mpp/awcdr/Config.in
```kconfig
if PACKAGE_eyesee-mpp-awcdr

choice
	prompt "select display sink"
	default hdmi_1080p
	help
	  select the display sink for app

config hdmi_1080p
	bool "use hdmi 1080p"

config lcd_720p
	bool "use lcd 720p"

endchoice

endif
```

## allwinner/tina_multimedia/Config.in
```kconfig
menu "Select cedarx configuration options"
comment "Video Encoders ---"
config CEDAR_VIDEO_ENCODER_ALL
	depends on TRECORDER
	bool "Enable all cedarc video encoders"

comment "Muxers ---"

config CEDAR_MUXER_ALL
	depends on TRECORDER
	bool "Select all muxers"

comment "Audio Encoders ---"

config CEDAR_AENCODER_ALL
	depends on TRECORDER
	bool "Select all audio encoders"

comment "Video Decoders ---"

config CEDAR_VDECODER_H264
	depends on TPLAYER
	default y if PLATFORM_r16=y
	default y if PLATFORM_r40=y
	default y if PLATFORM_r7=y
	default y if PLATFORM_r11=y
	default y if PLATFORM_r6=y
	default y if PLATFORM_c200s=y
	default y if PLATFORM_r18=y
	default y if PLATFORM_r30=y
	default y if PLATFORM_r311=y
	default y if PLATFORM_mr133=y
	default y if PLATFORM_r333=y
	default y if PLATFORM_r331=y
	default y if PLATFORM_r7s=y
	default y if PLATFORM_v306=y
	default y if PLATFORM_t7=y
	default y if PLATFORM_r58=y
	default y if PLATFORM_r332=y
	default y if PLATFORM_dolphin=y
	default y if PLATFORM_h3=y
	default y if PLATFORM_h6=y
	bool "AVC(h.264) video decoder"

config CEDAR_VDECODER_AVS
	depends on TPLAYER
	depends on  PLATFORM_r40 ||  PLATFORM_r18 || PLATFORM_r30 || PLATFORM_r311 || PLATFORM_t7 || PLATFORM_dolphin || PLATFORM_h3 ||  PLATFORM_h6 || PLATFORM_mr133
	default y if PLATFORM_r40=y
	default y if PLATFORM_r18=y
	default y if PLATFORM_r30=y
	default y if PLATFORM_r311=y
	default y if PLATFORM_mr133=y
	default y if PLATFORM_t7=y
	default y if PLATFORM_dolphin=y
	default y if PLATFORM_h3=y
	default y if PLATFORM_h6=y
	bool "AVS video decoder"

config CEDAR_VDECODER_H265
	depends on TPLAYER
	depends on  PLATFORM_r18 || PLATFORM_r30 || PLATFORM_r311 || PLATFORM_t7 || PLATFORM_dolphin || PLATFORM_h3 ||  PLATFORM_h6 || PLATFORM_mr133
	default y if PLATFORM_r18=y
	default y if PLATFORM_r30=y
	default y if PLATFORM_r311=y
	default y if PLATFORM_mr133=y
	default y if PLATFORM_t7=y
	default y if PLATFORM_dolphin=y
	default y if PLATFORM_h3=y
	default y if PLATFORM_h6=y
	bool "H265 video decoder"

config CEDAR_VDECODER_MJPEG
	depends on TPLAYER
	depends on PLATFORM_r16 || PLATFORM_r40 || PLATFORM_r11 || PLATFORM_r7 || PLATFORM_r6 || PLATFORM_c200s||  PLATFORM_r18 || PLATFORM_r30 || PLATFORM_r311 || PLATFORM_r333 || PLATFORM_r331 || PLATFORM_r7s || PLATFORM_t7 || PLATFORM_r58 || PLATFORM_r332 || PLATFORM_v306 || PLATFORM_dolphin || PLATFORM_h3 ||  PLATFORM_h6 || PLATFORM_mr133
	default y if PLATFORM_r16=y
	default y if PLATFORM_r40=y
	default y if PLATFORM_r7=y
	default y if PLATFORM_r11=y
	default y if PLATFORM_r6=y
	default y if PLATFORM_c200s=y
	default y if PLATFORM_r18=y
	default y if PLATFORM_r30=y
	default y if PLATFORM_r311=y
	default y if PLATFORM_mr133=y
	default y if PLATFORM_r333=y
	default y if PLATFORM_r331=y
	default y if PLATFORM_r7s=y
	default y if PLATFORM_v306=y
	default y if PLATFORM_t7=y
	default y if PLATFORM_r58=y
	default y if PLATFORM_r332=y
	default y if PLATFORM_dolphin=y
	default y if PLATFORM_h3=y
	default y if PLATFORM_h6=y
	bool "MJPEG(motion jpeg) video decoder"

config CEDAR_VDECODER_MPEG2
	depends on TPLAYER
	depends on PLATFORM_r16 || PLATFORM_r40 || PLATFORM_r6 || PLATFORM_c200s ||  PLATFORM_r18 || PLATFORM_r30 || PLATFORM_r311 || PLATFORM_t7 || PLATFORM_r58 || PLATFORM_dolphin || PLATFORM_h3 ||  PLATFORM_h6 || PLATFORM_mr133
	default y if PLATFORM_r16=y
	default y if PLATFORM_r40=y
	default y if PLATFORM_r6=y
	default y if PLATFORM_c200s=y
	default y if PLATFORM_r18=y
	default y if PLATFORM_r30=y
	default y if PLATFORM_r311=y
	default y if PLATFORM_mr133=y
	default y if PLATFORM_t7=y
	default y if PLATFORM_r58=y
	default y if PLATFORM_dolphin=y
	default y if PLATFORM_h3=y
	default y if PLATFORM_h6=y
	bool "MPEG2 video decoder"

config CEDAR_VDECODER_MPEG4BASE
	depends on TPLAYER
	depends on PLATFORM_r16 || PLATFORM_r40 || PLATFORM_r6 || PLATFORM_c200s ||  PLATFORM_r18 || PLATFORM_r30 || PLATFORM_r311 || PLATFORM_t7 || PLATFORM_r58 || PLATFORM_dolphin || PLATFORM_h3 ||  PLATFORM_h6 || PLATFORM_mr133
	default y if PLATFORM_r16=y
	default y if PLATFORM_r40=y
	default y if PLATFORM_r6=y
	default y if PLATFORM_c200s=y
	default y if PLATFORM_r18=y
	default y if PLATFORM_r30=y
	default y if PLATFORM_r311=y
	default y if PLATFORM_mr133=y
	default y if PLATFORM_t7=y
	default y if PLATFORM_r58=y
	default y if PLATFORM_dolphin=y
	default y if PLATFORM_h3=y
	default y if PLATFORM_h6=y
	bool "MPEG4 base profile video decoder"

config CEDAR_VDECODER_MPEG4DX
	depends on TPLAYER && CEDAR_VDECODER_MPEG4BASE
	depends on PLATFORM_r16 || PLATFORM_r40 || PLATFORM_r6 || PLATFORM_c200s ||  PLATFORM_r18 || PLATFORM_r30 || PLATFORM_r311 || PLATFORM_t7 || PLATFORM_r58 || PLATFORM_dolphin || PLATFORM_h3 ||  PLATFORM_h6 || PLATFORM_mr133
	default y if PLATFORM_r16=y
	default y if PLATFORM_r40=y
	default y if PLATFORM_r6=y
	default y if PLATFORM_c200s=y
	default y if PLATFORM_r18=y
	default y if PLATFORM_r30=y
	default y if PLATFORM_r311=y
	default y if PLATFORM_mr133=y
	default y if PLATFORM_t7=y
	default y if PLATFORM_r58=y
	default y if PLATFORM_dolphin=y
	default y if PLATFORM_h3=y
	default y if PLATFORM_h6=y
	bool "mpeg4 DIVX video decoder"

config CEDAR_VDECODER_MPEG4H263
	depends on TPLAYER && CEDAR_VDECODER_MPEG4BASE
	depends on PLATFORM_r16 || PLATFORM_r40 || PLATFORM_r6 || PLATFORM_c200s ||  PLATFORM_r18 || PLATFORM_r311 || PLATFORM_t7 || PLATFORM_r58 || PLATFORM_dolphin || PLATFORM_h3 ||  PLATFORM_h6 || PLATFORM_mr133
	default y if PLATFORM_r16=y
	default y if PLATFORM_r40=y
	default y if PLATFORM_r6=y
	default y if PLATFORM_c200s=y
	default y if PLATFORM_r18=y
	default y if PLATFORM_r30=y
	default y if PLATFORM_r311=y
	default y if PLATFORM_mr133=y
	default y if PLATFORM_t7=y
	default y if PLATFORM_r58=y
	default y if PLATFORM_dolphin=y
	default y if PLATFORM_h3=y
	default y if PLATFORM_h6=y
	bool "H263 video decoder"

config CEDAR_VDECODER_MPEG4NORMAL
	depends on TPLAYER && CEDAR_VDECODER_MPEG4BASE
	depends on PLATFORM_r16 || PLATFORM_r40 || PLATFORM_r6 || PLATFORM_c200s ||  PLATFORM_r18 || PLATFORM_r30 || PLATFORM_r311 || PLATFORM_t7 || PLATFORM_r58 || PLATFORM_dolphin || PLATFORM_h3 ||  PLATFORM_h6 || PLATFORM_mr133
	default y if PLATFORM_r16=y
	default y if PLATFORM_r40=y
	default y if PLATFORM_r6=y
	default y if PLATFORM_c200s=y
	default y if PLATFORM_r18=y
	default y if PLATFORM_r30=y
	default y if PLATFORM_r311=y
	default y if PLATFORM_mr133=y
	default y if PLATFORM_t7=y
	default y if PLATFORM_r58=y
	default y if PLATFORM_dolphin=y
	default y if PLATFORM_h3=y
	default y if PLATFORM_h6=y
	bool "MPEG4 normal video decoder"

config CEDAR_VDECODER_MPEG4VP6
	depends on TPLAYER && CEDAR_VDECODER_MPEG4BASE
	depends on PLATFORM_r16 || PLATFORM_r40 ||  PLATFORM_r18 || PLATFORM_dolphin || PLATFORM_h3 ||  PLATFORM_h6
	default y if PLATFORM_r16=y
	default y if PLATFORM_r40=y
	default y if PLATFORM_r18=y
	default y if PLATFORM_dolphin=y
	default y if PLATFORM_h3=y
	default y if PLATFORM_h6=y
	bool "VP6 video decoder"

config CEDAR_VDECODER_VP8
	depends on TPLAYER
	depends on PLATFORM_r16 || PLATFORM_r40 ||  PLATFORM_r18 || PLATFORM_r30 || PLATFORM_r311 || PLATFORM_t7 || PLATFORM_r58 || PLATFORM_dolphin || PLATFORM_h3 ||  PLATFORM_h6 || PLATFORM_mr133
	default y if PLATFORM_r16=y
	default y if PLATFORM_r40=y
	default y if PLATFORM_r18=y
	default y if PLATFORM_r30=y
	default y if PLATFORM_r311=y
	default y if PLATFORM_mr133=y
	default y if PLATFORM_t7=y
	default y if PLATFORM_r58=y
	default y if PLATFORM_dolphin=y
	default y if PLATFORM_h3=y
	default y if PLATFORM_h6=y
	bool "VP8 video decoder"

config CEDAR_VDECODER_VP9
	depends on TPLAYER
	depends on PLATFORM_r30 ||  PLATFORM_h6
	default y if PLATFORM_r30=y
	default y if PLATFORM_h6=y
	bool "VP9 video decoder"

config CEDAR_VDECODER_WMV3
	depends on TPLAYER
	depends on PLATFORM_r16 || PLATFORM_r40 ||  PLATFORM_r18 || PLATFORM_r30 || PLATFORM_r311 || PLATFORM_t7 || PLATFORM_r58 || PLATFORM_dolphin || PLATFORM_h3 ||  PLATFORM_h6 || PLATFORM_mr133
	default y if PLATFORM_r16=y
	default y if PLATFORM_r40=y
	default y if PLATFORM_r18=y
	default y if PLATFORM_r30=y
	default y if PLATFORM_r311=y
	default y if PLATFORM_mr133=y
	default y if PLATFORM_t7=y
	default y if PLATFORM_r58=y
	default y if PLATFORM_dolphin=y
	default y if PLATFORM_h3=y
	default y if PLATFORM_h6=y
	bool "VC1(WMV3) video decoder"

comment "Audio Decoders ---"

config CEDAR_ADECODER_AAC
	depends on TPLAYER
	default y
	bool "AAC audio decoder"

config CEDAR_ADECODER_ALAC
	depends on TPLAYER
	default n if TARGET_r11_GW=y
	default y
	bool "ALAC audio decoder"

config CEDAR_ADECODER_AMR
	depends on TPLAYER
	default n if TARGET_r11_GW=y
	default y
	bool "AMR audio decoder"

config CEDAR_ADECODER_APE
	depends on TPLAYER
	default n if TARGET_r11_GW=y
	default y
	bool "APE audio decoder"

config CEDAR_ADECODER_ATRC
	depends on TPLAYER
	default n if TARGET_r11_GW=y
	default y
	bool "ATRC audio decoder"

config CEDAR_ADECODER_COOK
	depends on TPLAYER
	default n if TARGET_r11_GW=y
	default y
	bool "COOK audio decoder"

config CEDAR_ADECODER_FLAC
	depends on TPLAYER
	default n if TARGET_r11_GW=y
	default y
	bool "FLAC audio decoder"

config CEDAR_ADECODER_MP3
	depends on TPLAYER
	default n if TARGET_r11_GW=y
	default y
	bool "MP3 audio decoder"

config CEDAR_ADECODER_OGG
	depends on TPLAYER
	default n if TARGET_r11_GW=y
	default y
	bool "OGG audio decoder"

config CEDAR_ADECODER_SIPR
	depends on TPLAYER
	default n if TARGET_r11_GW=y
	default y
	bool "SIPR audio decoder"

config CEDAR_ADECODER_WAV
	depends on TPLAYER
	default y
	bool "WAV audio decoder"

config CEDAR_ADECODER_RA
	depends on TPLAYER
	default n if TARGET_r11_GW=y
	default y
	bool "RA audio decoder"

config CEDAR_ADECODER_DSD
	depends on TPLAYER
	default n if TARGET_r11_GW=y
	default y
	bool "DSD audio decoder"

config CEDAR_ADECODER_G729
	depends on TPLAYER
	default n if TARGET_r11_GW=y
	default y
	bool "G729 audio decoder"

config CEDAR_ADECODER_OPUS
	depends on TPLAYER
	default n if TARGET_r11_GW=y
	default y
	bool "OPUS audio decoder"

comment "Subtitle Decoders ---"

config CEDAR_SUBTITLE_SUPPORT
	depends on TPLAYER
	bool "Select all subtitle decoders"

comment "Parsers ---"
config CEDAR_PARSER_ALL
	depends on TPLAYER
	bool "Select all parsers"


comment "Streams ---"

config CEDAR_STREAM_ALL
	depends on TPLAYER
	bool "Select all streams"

config RTSP_CLIENT_STREAM
	depends on TPLAYER
	default n
	bool "Support rtsp stream"

comment "Middleware ---"
config TPLAYER
	depends on PACKAGE_libcedarx
	select CEDAR_SUBTITLE_SUPPORT
	select CEDAR_PARSER_ALL
	select CEDAR_STREAM_ALL
	default y
	bool "Select tplayer middleware"

config TRECORDER
	depends on PACKAGE_libcedarx
	select CEDAR_VIDEO_ENCODER_ALL
	select CEDAR_AENCODER_ALL
	select CEDAR_MUXER_ALL
	default y
	bool "Select trecorder middleware"

config TMETADATARETRIVER
	depends on TPLAYER
	default y
	bool "Select tmetadataretriver middleware"

config JPEGDECODER
	depends on TPLAYER
	depends on CEDAR_VDECODER_MJPEG
	default y
	bool "Select JPEGDECODER middleware"

comment "OMX interface support ---"
config OMX
	depends on TPLAYER && TRECORDER
	select PACKAGE_libstdcpp
	default y if CONFIG_PACKAGE_gst-omx=y
	default n if TARGET_r11_GW=y
	bool "Add for openmax support"
endmenu


menu "Select Cedarx memory options"
config CUSTOM_VBV_ENABLE
	depends on TPLAYER
	default y if TARGET_r6_perf1=y
	default y if TARGET_r6_db=y
	default y if TARGET_c200s_F1C200s=y
	default n
	bool "Set VBV size by customer"

config VBVBUFSIZE
	depends on CUSTOM_VBV_ENABLE
	default 1
	int "Set VBV buffer size for tplayer in MB"

config SCALE_DOWN_ENABLE
	depends on TPLAYER
	default y if TARGET_r11_GW=y
	bool "Set Custom scaledown enable"

config SCALE_DOWN_WIDTH_LIMIT
	depends on SCALE_DOWN_ENABLE
	default 1920
	int "Do scaledown when width is equal or beyond this value"

config SCALE_DOWN_RATIO
	depends on SCALE_DOWN_ENABLE
	default 1
	int "Scale down ratio which can be 1,2 or 3"

config CUSTOM_FBM_NUM_ENABLE
	depends on TPLAYER
	default n
	bool "Set FBM number by customer"

config FBM_DISPLAY_HOLDING
	depends on CUSTOM_FBM_NUM_ENABLE
	default 3
	int "FBM number which display holds"

config FBM_DEINTERLEACED_USED
	depends on CUSTOM_FBM_NUM_ENABLE
	default 2
	int "FBM number deinterleace use"

config FBM_ROTATE_USED
	depends on CUSTOM_FBM_NUM_ENABLE
	default 0
	int "FBM numer rotate used"

config FBM_SMOOTHLY_USED
	depends on CUSTOM_FBM_NUM_ENABLE
	default 3
	int "FBM number which used to play smoothly"

config USE_ION_BUF_ENABLE
	default n
	default y if TARGET_r11_GW=y
	bool "Set ion enable"

config CUSTOM_CACHE_ENABLE
	default n
	default y if TARGET_r11_R11_pref1=y
	default y if TARGET_r328s2=y
	default y if TARGET_r328s3=y
	bool "Set cache size by customer"

config CACHE_BUFFER_SIZE
	depends on CUSTOM_CACHE_ENABLE
	default 20480
	default 5120 if TARGET_r11_R11_pref1=y
	default 5120 if TARGET_r328s2=y
	default 5120 if TARGET_r328s3=y
	int "Set cache buffer size for tplayer in KB"

config LIVE_CACHE_BUFFER_SIZE
	depends on CUSTOM_CACHE_ENABLE
	default 20480
	default 6124 if TARGET_r11_R11_pref1=y
	default 6124 if TARGET_r328s2=y
	default 6124 if TARGET_r328s3=y
	int "Set live cache buffer size for tplayer in KB"

config HTTP_STREAM_CACHE_SIZE
	depends on CUSTOM_CACHE_ENABLE
	default 5120
	int "Set http cache size for tplayer in KB"

config START_PLAY_CACHE_TIME
	depends on CUSTOM_CACHE_ENABLE
	default 5
	default 3 if TARGET_r11_R11_pref1=y
	default 3 if TARGET_r328s2-std=y
	default 3 if TARGET_r328s3-std=y
	int "Set start play cache time for tplayer in SECOND"

endmenu

choice
prompt "Choose whether to use VIN ISP"
	default TR_NO_USE_VIN_ISP
	help
		Choose whether to compile VIN ISP.
config TR_YES_USE_VIN_ISP
	select PACKAGE_libAWIspApi
	bool "YES"
config TR_NO_USE_VIN_ISP
	bool "NO"
endchoice

choice
prompt "Choose whether to use playready"
	default CEDARX_NO_USE_PLAYREADY
	help
		Choose whether to use playready.
config CEDARX_YES_USE_PLAYREADY
	select PACKAGE_playready
	bool "YES"
config CEDARX_NO_USE_PLAYREADY
	bool "NO"
endchoice
```
